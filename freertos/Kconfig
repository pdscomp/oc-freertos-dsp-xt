## freertos/Kconfig
```kconfig
mainmenu "Cadence Xtensa DSP Configuration"

menu "Target options"
source "arch/Kconfig"
endmenu

menu "Kernel options"
source "kernel/Kconfig"
endmenu

menu "Drivers options"
source "drivers/Kconfig"
endmenu

menu "Components options"
source "components/Kconfig"
endmenu

menu "Projects options"
source "projects/Kconfig"
endmenu
```

## freertos/arch/Kconfig
```kconfig
choice
	prompt "Target SoC platform"
	default ARCH_SUN50IW11

config ARCH_SUN50IW11
	bool "sun50iw11"

config ARCH_SUN8IW20
	bool "sun8iw20"

config ARCH_SUN20IW2
	bool "sun20iw2"

endchoice

# define include arch dir
config ARCH_PLATFORM
	string
	default "sun8iw20" if ARCH_SUN8IW20
	default "sun20iw2" if ARCH_SUN20IW2
	default "sun50iw11" if ARCH_SUN50IW11

# define the development board
choice
	prompt "Development boards"
	default EVB_PLATFORM

config FPGA_PLATFORM
	bool "FPGA board"

config EVB_PLATFORM
	bool "EVB board"

endchoice

# define DSP core
choice
	prompt "Select DSP core"
	default CORE_DSP0

config CORE_DSP0
	bool "Core 0"

config CORE_DSP1
	bool "Core 1"
	depends on ARCH_SUN50IW11

endchoice

# define dsp core id 
config CORE_ID
	string
	default "dsp0" if CORE_DSP0
	default "dsp1" if CORE_DSP1

# choice LSP
choice
	prompt "Select LSP"
	default LSP_NORMAL_START

config LSP_NORMAL_START
	bool "LSP for normal start"

config LSP_JTAG_START
	bool "LSP for jtag start"

config LSP_PERF_MEM_TEST
	bool "LSP for perf_mem test"

endchoice

# define the lsp
if ARCH_SUN8IW20
source "arch/sun8iw20/Kconfig"
endif
```

## freertos/components/Kconfig
```kconfig
comment "System components"

menu "Allwinner components"

config COMPONENTS_AW
	bool
	default y

source "components/aw/Kconfig"

endmenu

menu "Thirdparty components"

config COMPONENTS_THIRDPARTY
	bool
	default y

source "components/thirdparty/Kconfig"

endmenu
```

## freertos/components/aw/backtrace/Kconfig
```kconfig
menu "Backtrace Support"

config DEBUG_BACKTRACE
	bool "Enable backtrace for HIFI4"
	default y

endmenu
```

## freertos/components/aw/sound/aw-alsa-utils/Kconfig
```kconfig
config COMPONENTS_AW_ALSA_UTILS_DSP
	bool "Allwinner alsa dsp utilities"
	depends on COMPONENTS_AW_ALSA_LIB_DSP
	default n
	help
	  This is package for aw-alsa-lib utilities, only used for Allwinner DSP RTOS.

config COMPONENTS_AW_ALSA_UTILS_APLAY_DSP
	bool "Allwinner alsa dsp <aplay>"
	depends on COMPONENTS_AW_ALSA_UTILS_DSP
	default n
	help
	  This is package for aw-alsa-lib utilities, only used for Allwinner DSP RTOS.

config COMPONENTS_AW_ALSA_UTILS_ARECORD_DSP
	bool "Allwinner alsa dsp <arecord>"
	depends on COMPONENTS_AW_ALSA_UTILS_DSP
	default n
	help
	  This is package for aw-alsa-lib utilities, only used for Allwinner DSP RTOS.

config COMPONENTS_AW_ALSA_UTILS_AMIXER_DSP
	bool "Allwinner alsa dsp <amixer>"
	depends on COMPONENTS_AW_ALSA_UTILS_DSP
	default n
	help
	  This is package for aw-alsa-lib utilities, only used for Allwinner DSP RTOS.

config COMPONENTS_AW_ALSA_UTILS_BUILTIN_WAV_DSP
	bool "Allwinner alsa dsp builtin wav file"
	depends on COMPONENTS_AW_ALSA_UTILS_APLAY_DSP
	default n
	help
	  This is package for aw-alsa-lib utilities, only used for Allwinner DSP RTOS.

config COMPONENTS_AW_ALSA_UTILS_ALOOP_DSP
	bool "Allwinner alsa dsp <aloop>"
	depends on COMPONENTS_AW_ALSA_UTILS_DSP
	default n
	help
	  This is package for aw-alsa-lib utilities, only used for Allwinner DSP RTOS.
```

## freertos/components/aw/sound/aw-rpaf/Kconfig
```kconfig
config COMPONENTS_AW_ALSA_RPAF_COMPONENT
	bool "Allwinner rpaf component"
	depends on COMPONENTS_AW_ALSA_RPAF
	default n
	help
		This is package for aw-rpaf, only used for Allwinner DSP RTOS.

config COMPONENTS_AW_ALSA_RPAF_REMOTE_AMP
	int "msgbox remote amp id"
	default 0
	depends on COMPONENTS_AW_ALSA_RPAF
	help
		msgbox remote amp id

config COMPONENTS_AW_ALSA_RPAF_READ_CH
	int "msgbox read channel"
	default 1
	depends on COMPONENTS_AW_ALSA_RPAF
	help
		msgbox read channel

config COMPONENTS_AW_ALSA_RPAF_WRITE_CH
	int "msgbox write channel"
	default 1
	depends on COMPONENTS_AW_ALSA_RPAF
	help
		msgbox write channel
```

## freertos/components/thirdparty/freertos/FreeRTOS-Plus-CLI/Kconfig
```kconfig
config COMPONENTS_FREERTOS_CLI
	bool "FreeRTOS Plus CLI"
	default n

if COMPONENTS_FREERTOS_CLI
menu "Supported commands"
source "components/thirdparty/freertos/FreeRTOS-Plus-CLI/commands/Kconfig"
endmenu
endif
```

## freertos/components/thirdparty/freertos/FreeRTOS-Plus-CLI/commands/Kconfig
```kconfig
config FREERTOS_CLI_CMD_TEMPLATE
	bool "template command (for illustration)"
	default y

config FREERTOS_CLI_CMD_MEM_RW
	bool "Memory read/write"
	default n

config FREERTOS_CLI_CMD_FREE
	bool "Free Memory in Heap"
	default n
```

## freertos/kernel/Kconfig
```kconfig
config KERNEL_FREERTOS
	bool "Support FreeRTOS kernel"
	default y

if KERNEL_FREERTOS

choice
	prompt "Kernel version"
	default KERNEL_XTENSA_V1_7

config KERNEL_XTENSA_V1_7
	bool "Use freertos kernel xtensa v1.7"
endchoice

config KERNEL_VERSION_DIR
	string
	default "FreeRTOS_xtensa_v1.7" if KERNEL_XTENSA_V1_7

choice
	prompt "Heap Memory Manager"
	default MEMMANG_HEAP_4

config MEMMANG_HEAP_1
	bool "Use heap_1 to allocate memory"

config MEMMANG_HEAP_2
	bool "Use heap_2 to allocate memory"

config MEMMANG_HEAP_3
	bool "Use heap_3 to allocate memory"

config MEMMANG_HEAP_4
	bool "Use heap_4 to allocate memory"

config MEMMANG_HEAP_5
	bool "Use heap_5 to allocate memory"
endchoice

choice
	prompt "Portable"
	default PORT_XCC_XTENSA

config PORT_XCC_XTENSA
	bool "XCC/Xtensa"
	---help---
		FreeRTOS Port for Xtensa Configurable Processors
endchoice

config PORT_ARCH_DIR
	string
	default "xtensa" if PORT_XCC_XTENSA
	---help---
		This value must be corresponding to the name of
		the specific arch directory.

config PORT_XEA2
	bool
	default y if PORT_XCC_XTENSA
	---help---
		Xtensa Exception Architecture 2(XEA2) supports.

choice
	prompt "Xcc optimize registration"
	default XCC_O0

config XCC_O0
	bool "Use for debug about dsp"

config XCC_O2
	bool "Use for normal start about dsp"

config XCC_O3
	bool "Use for ultimate performance about dsp"
endchoice

config XCC_OPT
	string
	default "O0" if XCC_O0
	default "O2" if XCC_O2
	default "O3" if XCC_O3

endif
```

## freertos/projects/Kconfig
```kconfig
choice
	prompt "Configure Application"
	default PROJECT_SIM

config PROJECT_SIM
	bool "Cadence simulator demos"
	---help---
		the offical demos of foss-xtensa from Github

config PROJECT_R528
	bool "R528 DSP project"
	depends on ARCH_SUN8IW20

endchoice

config PROJECT_DIR
	string
	default "r528" if PROJECT_R528
	---help---
		This value must be corresponding to the name of
		the project directory.
```
